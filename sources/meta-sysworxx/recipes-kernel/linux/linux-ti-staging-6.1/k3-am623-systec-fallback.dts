/*
 * Copyright (C) 2023 SYSTEC electronic AG, All Rights Reserved
 *
 * This program is free software; you can redistribute it and/or modify
 * it under the terms of the GNU General Public License version 2 as
 * published by the Free Software Foundation.
 */
/dts-v1/;

#include "k3-am625.dtsi"
#include "k3-am623-systec-ctr800-pinmux-0.dtsi"
#include "k3-am623-systec-ctr-common.dtsi"

/ {
	model = "SYSTEC sysWORXX fallback";
	compatible = "systec,sysworxx", "ti,am625";
};

// SERIAL0
&main_uart4 {
	pinctrl-names = "default";
	pinctrl-0 = <&uart4_serial0_pins_default>;
	status = "okay";
};

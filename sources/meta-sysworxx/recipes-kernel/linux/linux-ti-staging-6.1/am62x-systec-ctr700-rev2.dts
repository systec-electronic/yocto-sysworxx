/*
 * Copyright (C) 2023 SYSTEC electronic AG, All Rights Reserved
 *
 * This program is free software; you can redistribute it and/or modify
 * it under the terms of the GNU General Public License version 2 as
 * published by the Free Software Foundation.
 */
/dts-v1/;

#include <dt-bindings/leds/common.h>
#include <dt-bindings/gpio/gpio.h>
#include <dt-bindings/net/ti-dp83867.h>

#include "k3-am625.dtsi"
#include "am62x-systec-ctr700-rev2-pinmux.dtsi"

/ {
	model = "SYSTEC sysWORXX CTR-700";
	compatible = "systec,ctr700,rev2", "systec,ctr700", "ti,am625";
};

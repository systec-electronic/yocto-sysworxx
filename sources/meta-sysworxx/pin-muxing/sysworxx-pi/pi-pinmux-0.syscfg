/**
 * @cliArgs --device "AM62x" --package "ALW" --part "Default"
 * @versions {"tool":"1.20.0+3587"}
 */

/**
 * Import the modules used in this configuration.
 */
const powerDomains = scripting.addModule("/ti/corePinmux/powerDomains");

/**
 * Write custom configuration values to the imported modules.
 */
powerDomains.VDDSHV0                      = "3.3 V";
powerDomains.VDDSHV2                      = "3.3 V";
powerDomains.VDDSHV3                      = "3.3 V";
powerDomains.VDDSHV_MCU                   = "3.3 V";
powerDomains.VDDSHV_CANUART               = "3.3 V";
powerDomains["VDDA_1P8_USB-VDDA_3P3_USB"] = "3.3 V";
powerDomains.VDDSHV1                      = "3.3 V";
powerDomains.VDDSHV5                      = "3.3 V";
powerDomains.VDDSHV6                      = "3.3 V";
powerDomains["VDDS_DDR-VDDS_DDR_C"]       = "1.2 V";

/**
 * These are the peripherals and settings in this configuration
 */
const iDDRSS1                      = scripting.addPeripheral("DDRSS");
iDDRSS1.$name                      = "DDR";
iDDRSS1.$assign                    = "DDR0";
iDDRSS1.$assignVoltage             = "1.2 V";
iDDRSS1.A0.$assign                 = "DDR0_A0";
iDDRSS1.A1.$assign                 = "DDR0_A1";
iDDRSS1.A10.$assign                = "DDR0_A10";
iDDRSS1.A11.$assign                = "DDR0_A11";
iDDRSS1.A12.$assign                = "DDR0_A12";
iDDRSS1.A13.$assign                = "DDR0_A13";
iDDRSS1.A2.$assign                 = "DDR0_A2";
iDDRSS1.A3.$assign                 = "DDR0_A3";
iDDRSS1.A4.$assign                 = "DDR0_A4";
iDDRSS1.A5.$assign                 = "DDR0_A5";
iDDRSS1.A6.$assign                 = "DDR0_A6";
iDDRSS1.A7.$assign                 = "DDR0_A7";
iDDRSS1.A8.$assign                 = "DDR0_A8";
iDDRSS1.A9.$assign                 = "DDR0_A9";
iDDRSS1.ACT_n.$assign              = "DDR0_ACT_n";
iDDRSS1.ALERT_n.$assign            = "DDR0_ALERT_n";
iDDRSS1.BA0.$assign                = "DDR0_BA0";
iDDRSS1.BA1.$assign                = "DDR0_BA1";
iDDRSS1.BG0.$assign                = "DDR0_BG0";
iDDRSS1.BG1.$used                  = false;
iDDRSS1.CAS_n.$assign              = "DDR0_CAS_n";
iDDRSS1.CK0.$assign                = "DDR0_CK0";
iDDRSS1.CK0_n.$assign              = "DDR0_CK0_n";
iDDRSS1.CKE0.$assign               = "DDR0_CKE0";
iDDRSS1.CKE1.$used                 = false;
iDDRSS1.CS0_n.$assign              = "DDR0_CS0_n";
iDDRSS1.CS1_n.$used                = false;
iDDRSS1.DM0.$assign                = "DDR0_DM0";
iDDRSS1.DM1.$assign                = "DDR0_DM1";
iDDRSS1.DQ0.$assign                = "DDR0_DQ0";
iDDRSS1.DQ1.$assign                = "DDR0_DQ1";
iDDRSS1.DQ10.$assign               = "DDR0_DQ10";
iDDRSS1.DQ11.$assign               = "DDR0_DQ11";
iDDRSS1.DQ12.$assign               = "DDR0_DQ12";
iDDRSS1.DQ13.$assign               = "DDR0_DQ13";
iDDRSS1.DQ14.$assign               = "DDR0_DQ14";
iDDRSS1.DQ15.$assign               = "DDR0_DQ15";
iDDRSS1.DQ2.$assign                = "DDR0_DQ2";
iDDRSS1.DQ3.$assign                = "DDR0_DQ3";
iDDRSS1.DQ4.$assign                = "DDR0_DQ4";
iDDRSS1.DQ5.$assign                = "DDR0_DQ5";
iDDRSS1.DQ6.$assign                = "DDR0_DQ6";
iDDRSS1.DQ7.$assign                = "DDR0_DQ7";
iDDRSS1.DQ8.$assign                = "DDR0_DQ8";
iDDRSS1.DQ9.$assign                = "DDR0_DQ9";
iDDRSS1.DQS0.$assign               = "DDR0_DQS0";
iDDRSS1.DQS0_n.$assign             = "DDR0_DQS0_n";
iDDRSS1.DQS1.$assign               = "DDR0_DQS1";
iDDRSS1.DQS1_n.$assign             = "DDR0_DQS1_n";
iDDRSS1.ODT0.$assign               = "DDR0_ODT0";
iDDRSS1.ODT1.$used                 = false;
iDDRSS1.PAR.$assign                = "DDR0_PAR";
iDDRSS1.RAS_n.$assign              = "DDR0_RAS_n";
iDDRSS1.RESET0_n.$assign           = "DDR0_RESET0_n";
iDDRSS1.WE_n.$assign               = "DDR0_WE_n";
iDDRSS1.CAL0.$assign               = "DDR0_CAL0";
const iDSS1                        = scripting.addPeripheral("DSS");
iDSS1.$useCase                     = "DSS_1";
iDSS1.$name                        = "HDMI-24BitRGB";
iDSS1.$assign                      = "DSS0";
iDSS1.$assignVoltage               = "3.3 V";
iDSS1.VSYNC.$assign                = "VOUT0_VSYNC";
iDSS1.HSYNC.$assign                = "VOUT0_HSYNC";
iDSS1.PCLK.$assign                 = "VOUT0_PCLK";
iDSS1.DE.$assign                   = "VOUT0_DE";
iDSS1.DATA0.$assign                = "VOUT0_DATA0";
iDSS1.DATA1.$assign                = "VOUT0_DATA1";
iDSS1.DATA2.$assign                = "VOUT0_DATA2";
iDSS1.DATA3.$assign                = "VOUT0_DATA3";
iDSS1.DATA4.$assign                = "VOUT0_DATA4";
iDSS1.DATA5.$assign                = "VOUT0_DATA5";
iDSS1.DATA6.$assign                = "VOUT0_DATA6";
iDSS1.DATA7.$assign                = "VOUT0_DATA7";
iDSS1.DATA8.$assign                = "VOUT0_DATA8";
iDSS1.DATA9.$assign                = "VOUT0_DATA9";
iDSS1.DATA10.$assign               = "VOUT0_DATA10";
iDSS1.DATA11.$assign               = "VOUT0_DATA11";
iDSS1.DATA12.$assign               = "VOUT0_DATA12";
iDSS1.DATA13.$assign               = "VOUT0_DATA13";
iDSS1.DATA14.$assign               = "VOUT0_DATA14";
iDSS1.DATA15.$assign               = "VOUT0_DATA15";
iDSS1.DATA16.$assign               = "GPMC0_AD8";
iDSS1.DATA17.$assign               = "GPMC0_AD9";
iDSS1.DATA18.$assign               = "GPMC0_AD10";
iDSS1.DATA19.$assign               = "GPMC0_AD11";
iDSS1.DATA20.$assign               = "GPMC0_AD12";
iDSS1.DATA21.$assign               = "GPMC0_AD13";
iDSS1.DATA22.$assign               = "GPMC0_AD14";
iDSS1.DATA23.$assign               = "GPMC0_AD15";
const iGPIO1                       = scripting.addPeripheral("GPIO");
iGPIO1["0"].pu_pd                  = "pd";
iGPIO1["0"].$assign                = "OSPI0_CLK";
iGPIO1["0"].$used                  = true;
iGPIO1["1"].rx                     = false;
iGPIO1["1"].$assign                = "OSPI0_LBCLKO";
iGPIO1["1"].$used                  = true;
iGPIO1["2"].pu_pd                  = "pd";
iGPIO1["2"].$assign                = "OSPI0_DQS";
iGPIO1["2"].$used                  = true;
iGPIO1["3"].rx                     = false;
iGPIO1["3"].$assign                = "OSPI0_D0";
iGPIO1["3"].$used                  = true;
iGPIO1["4"].rx                     = false;
iGPIO1["4"].$assign                = "OSPI0_D1";
iGPIO1["4"].$used                  = true;
iGPIO1["5"].rx                     = false;
iGPIO1["5"].$assign                = "OSPI0_D2";
iGPIO1["5"].$used                  = true;
iGPIO1["6"].rx                     = false;
iGPIO1["6"].$assign                = "OSPI0_D3";
iGPIO1["6"].$used                  = true;
iGPIO1["7"].pu_pd                  = "pd";
iGPIO1["7"].$assignAllowConflicts  = "OSPI0_D4";
iGPIO1["7"].$used                  = true;
iGPIO1["8"].pu_pd                  = "pd";
iGPIO1["8"].$assignAllowConflicts  = "OSPI0_D5";
iGPIO1["8"].$used                  = true;
iGPIO1["9"].pu_pd                  = "pd";
iGPIO1["9"].$assignAllowConflicts  = "OSPI0_D6";
iGPIO1["9"].$used                  = true;
iGPIO1["10"].pu_pd                 = "pd";
iGPIO1["10"].$assignAllowConflicts = "OSPI0_D7";
iGPIO1["10"].$used                 = true;
iGPIO1["11"].rx                    = false;
iGPIO1["11"].$assign               = "OSPI0_CSn0";
iGPIO1["11"].$used                 = true;
iGPIO1["12"].rx                    = false;
iGPIO1["12"].$assign               = "OSPI0_CSn1";
iGPIO1["12"].$used                 = true;
iGPIO1["13"].pu_pd                 = "pd";
iGPIO1["13"].$assign               = "OSPI0_CSn2";
iGPIO1["13"].$used                 = true;
iGPIO1["14"].rx                    = false;
iGPIO1["14"].$assign               = "OSPI0_CSn3";
iGPIO1["14"].$used                 = true;
iGPIO1["15"].$assign               = "GPMC0_AD0";
iGPIO1["15"].$used                 = true;
iGPIO1["16"].$assign               = "GPMC0_AD1";
iGPIO1["16"].$used                 = true;
iGPIO1["17"].$assign               = "GPMC0_AD2";
iGPIO1["17"].$used                 = true;
iGPIO1["18"].$assign               = "GPMC0_AD3";
iGPIO1["18"].$used                 = true;
iGPIO1["31"].rx                    = false;
iGPIO1["31"].$assign               = "GPMC0_CLK";
iGPIO1["31"].$used                 = true;
iGPIO1["33"].pu_pd                 = "pd";
iGPIO1["33"].$assign               = "GPMC0_OEn_REn";
iGPIO1["33"].$used                 = true;
iGPIO1["34"].pu_pd                 = "pd";
iGPIO1["34"].$assign               = "GPMC0_WEn";
iGPIO1["34"].$used                 = true;
iGPIO1["35"].rx                    = false;
iGPIO1["35"].$assign               = "GPMC0_BE0n_CLE";
iGPIO1["35"].$used                 = true;
iGPIO1["36"].$assign               = "GPMC0_BE1n";
iGPIO1["36"].$used                 = true;
iGPIO1["37"].pu_pd                 = "pd";
iGPIO1["37"].$assign               = "GPMC0_WAIT0";
iGPIO1["37"].$used                 = true;
iGPIO1["38"].$assign               = "GPMC0_WAIT1";
iGPIO1["38"].$used                 = true;
iGPIO1["40"].rx                    = false;
iGPIO1["40"].$assign               = "GPMC0_DIR";
iGPIO1["40"].$used                 = true;
iGPIO1["41"].rx                    = false;
iGPIO1["41"].$assign               = "GPMC0_CSn0";
iGPIO1["41"].$used                 = true;
iGPIO1["42"].$assign               = "GPMC0_CSn1";
iGPIO1["42"].$used                 = true;
iGPIO1["43"].pu_pd                 = "pd";
iGPIO1["43"].$assign               = "GPMC0_CSn2";
iGPIO1["43"].$used                 = true;
iGPIO1["44"].pu_pd                 = "pd";
iGPIO1["44"].$assign               = "GPMC0_CSn3";
iGPIO1["44"].$used                 = true;
iGPIO1["71"].pu_pd                 = "pd";
iGPIO1["71"].$assignAllowConflicts = "MMC2_SDCD";
iGPIO1["71"].$used                 = true;
iGPIO1["72"].pu_pd                 = "pd";
iGPIO1["72"].$assignAllowConflicts = "MMC2_SDWP";
iGPIO1["72"].$used                 = true;
iGPIO1["85"].pu_pd                 = "pu";
iGPIO1["86"].pu_pd                 = "pu";
iGPIO1["86"].rx                    = false;
iGPIO1.$name                       = "GPIO_0";
const iGPIO2                       = scripting.addPeripheral("GPIO");
iGPIO2["8"].rx                     = false;
iGPIO2["8"].$assign                = "MCASP0_AXR2";
iGPIO2["8"].$used                  = true;
iGPIO2["9"].pu_pd                  = "pd";
iGPIO2["9"].$assign                = "MCASP0_AXR1";
iGPIO2["9"].$used                  = true;
iGPIO2["13"].$assign               = "MCASP0_AFSR";
iGPIO2["13"].$used                 = true;
iGPIO2["14"].rx                    = false;
iGPIO2["14"].$assign               = "MCASP0_ACLKR";
iGPIO2["14"].$used                 = true;
iGPIO2["15"].$assign               = "SPI0_CS0";
iGPIO2["15"].$used                 = true;
iGPIO2["16"].$assign               = "SPI0_CS1";
iGPIO2["16"].$used                 = true;
iGPIO2["17"].$assign               = "SPI0_CLK";
iGPIO2["17"].$used                 = true;
iGPIO2["18"].$assign               = "SPI0_D0";
iGPIO2["18"].$used                 = true;
iGPIO2["19"].$assign               = "SPI0_D1";
iGPIO2["19"].$used                 = true;
iGPIO2["22"].pu_pd                 = "pd";
iGPIO2["22"].$assignAllowConflicts = "UART0_CTSn";
iGPIO2["22"].$used                 = true;
iGPIO2["23"].pu_pd                 = "pd";
iGPIO2["23"].$assignAllowConflicts = "UART0_RTSn";
iGPIO2["23"].$used                 = true;
iGPIO2["24"].pu_pd                 = "pd";
iGPIO2["24"].$assignAllowConflicts = "MCAN0_TX";
iGPIO2["24"].$used                 = true;
iGPIO2["25"].pu_pd                 = "pd";
iGPIO2["25"].$assignAllowConflicts = "MCAN0_RX";
iGPIO2["25"].$used                 = true;
iGPIO2["28"].pu_pd                 = "pd";
iGPIO2["28"].$assign               = "I2C1_SCL";
iGPIO2["28"].$used                 = true;
iGPIO2["29"].pu_pd                 = "pu";
iGPIO2["29"].rx                    = false;
iGPIO2["29"].$assign               = "I2C1_SDA";
iGPIO2["29"].$used                 = true;
iGPIO2["49"].$assign               = "MMC1_SDWP";
iGPIO2["49"].$used                 = true;
iGPIO2["50"].pu_pd                 = "pd";
iGPIO2["50"].rx                    = false;
iGPIO2["50"].$assign               = "USB0_DRVVBUS";
iGPIO2["50"].$used                 = true;
iGPIO2["51"].pu_pd                 = "pd";
iGPIO2["51"].rx                    = false;
iGPIO2["51"].$assign               = "USB1_DRVVBUS";
iGPIO2["51"].$used                 = true;
iGPIO2.$name                       = "GPIO_1";
iGPIO2.$assign                     = "GPIO1";
const iI2C1                        = scripting.addPeripheral("I2C");
iI2C1.$name                        = "I2C0_Board";
iI2C1.$assign                      = "I2C0";
iI2C1.$assignVoltage               = "3.3 V";
iI2C1.SCL.$assign                  = "I2C0_SCL";
iI2C1.SDA.$assign                  = "I2C0_SDA";
const iI2C2                        = scripting.addPeripheral("I2C");
iI2C2.$name                        = "I2C3";
iI2C2.$assign                      = "I2C3";
iI2C2.$assignVoltage               = "3.3 V";
iI2C2.SCL.pu_pd                    = "nopull";
iI2C2.SCL.rx                       = false;
iI2C2.SCL.$assignAllowConflicts    = "UART0_CTSn";
iI2C2.SDA.pu_pd                    = "nopull";
iI2C2.SDA.$assignAllowConflicts    = "UART0_RTSn";
const iMCAN1                       = scripting.addPeripheral("MCAN");
iMCAN1.$useCase                    = "MCAN_1";
iMCAN1.$name                       = "MCAN0";
iMCAN1.$assign                     = "MCAN0";
iMCAN1.RX.$assignAllowConflicts    = "MCAN0_RX";
iMCAN1.TX.$assignAllowConflicts    = "MCAN0_TX";
const iMCASP1                      = scripting.addPeripheral("MCASP");
iMCASP1.$name                      = "HDMI_Audio";
iMCASP1.$assign                    = "MCASP0";
iMCASP1.ACLKX.$assign              = "MCASP0_ACLKX";
iMCASP1.AFSX.$assign               = "MCASP0_AFSX";
iMCASP1.$pinGroup.AXR0.$assign     = "MCASP0_AXR0";
iMCASP1.$pinGroup.AXR1.$used       = false;
iMCASP1.$pinGroup.AXR2.$used       = false;
iMCASP1.$pinGroup.AXR3.$used       = false;
iMCASP1.$pinGroup.AXR4.$used       = false;
iMCASP1.$pinGroup.AXR5.$used       = false;
iMCASP1.$pinGroup.AXR6.$used       = false;
iMCASP1.$pinGroup.AXR7.$used       = false;
iMCASP1.$pinGroup.AXR8.$used       = false;
iMCASP1.$pinGroup.AXR9.$used       = false;
iMCASP1.$pinGroup.AXR10.$used      = false;
iMCASP1.$pinGroup.AXR11.$used      = false;
iMCASP1.$pinGroup.AXR12.$used      = false;
iMCASP1.$pinGroup.AXR13.$used      = false;
iMCASP1.$pinGroup.AXR14.$used      = false;
iMCASP1.$pinGroup.AXR15.$used      = false;
const iMCU_GPIO1                   = scripting.addPeripheral("MCU_GPIO");
iMCU_GPIO1["13"].rx                = false;
iMCU_GPIO1["13"].$assign           = "MCU_MCAN0_TX";
iMCU_GPIO1["13"].$used             = true;
iMCU_GPIO1["14"].pu_pd             = "pd";
iMCU_GPIO1["14"].$assign           = "MCU_MCAN0_RX";
iMCU_GPIO1["14"].$used             = true;
iMCU_GPIO1.$name                   = "MCU_GPIO1";
iMCU_GPIO1.$assign                 = "MCU_GPIO0";
iMCU_GPIO1.$assignVoltage          = "3.3 V";
const iMCU_I2C1                    = scripting.addPeripheral("MCU_I2C");
iMCU_I2C1.$name                    = "MCU_I2C1_RTC";
iMCU_I2C1.SCL.$assign              = "MCU_I2C0_SCL";
iMCU_I2C1.SDA.$assign              = "MCU_I2C0_SDA";
const iMCU_UART1                   = scripting.addPeripheral("MCU_UART");
iMCU_UART1.$useCase                = "MCU_UART_1";
iMCU_UART1.$name                   = "MCU_UART0-Bluetooth";
iMCU_UART1.$assign                 = "MCU_USART0";
iMCU_UART1.$assignVoltage          = "3.3 V";
iMCU_UART1.RXD.pu_pd               = "pu";
iMCU_UART1.RXD.$assign             = "MCU_UART0_RXD";
iMCU_UART1.TXD.pu_pd               = "pu";
iMCU_UART1.TXD.$assign             = "MCU_UART0_TXD";
iMCU_UART1.CTSn.pu_pd              = "pu";
iMCU_UART1.CTSn.$assign            = "MCU_UART0_CTSn";
iMCU_UART1.RTSn.pu_pd              = "pu";
iMCU_UART1.RTSn.$assign            = "MCU_UART0_RTSn";
const iMDIO1                       = scripting.addPeripheral("MDIO");
iMDIO1.$name                       = "MDIO0";
iMDIO1.MDC.pu_pd                   = "pu";
iMDIO1.MDC.$assign                 = "MDIO0_MDC";
iMDIO1.MDIO.pu_pd                  = "pu";
iMDIO1.MDIO.$assign                = "MDIO0_MDIO";
const iMMC01                       = scripting.addPeripheral("MMC0");
iMMC01.$useCase                    = "MMC0_3";
iMMC01.$name                       = "MMC0-EMMC";
iMMC01.$assign                     = "MMC0";
iMMC01.$assignVoltage              = "1.8 V";
iMMC01.CMD.$assign                 = "MMC0_CMD";
iMMC01.CLK.$assign                 = "MMC0_CLK";
iMMC01.DAT0.$assign                = "MMC0_DAT0";
iMMC01.DAT1.$assign                = "MMC0_DAT1";
iMMC01.DAT2.$assign                = "MMC0_DAT2";
iMMC01.DAT3.$assign                = "MMC0_DAT3";
iMMC01.DAT4.$assign                = "MMC0_DAT4";
iMMC01.DAT5.$assign                = "MMC0_DAT5";
iMMC01.DAT6.$assign                = "MMC0_DAT6";
iMMC01.DAT7.$assign                = "MMC0_DAT7";
const iMMC11                       = scripting.addPeripheral("MMC1");
iMMC11.$useCase                    = "MMC1_3";
iMMC11.$name                       = "MMC1-SDCARD";
iMMC11.$assign                     = "MMC1";
iMMC11.$assignVoltage              = "3.3 V";
iMMC11.CMD.pu_pd                   = "pu";
iMMC11.CMD.$assign                 = "MMC1_CMD";
iMMC11.CLK.$assign                 = "MMC1_CLK";
iMMC11.DAT0.pu_pd                  = "pu";
iMMC11.DAT0.$assign                = "MMC1_DAT0";
iMMC11.DAT1.pu_pd                  = "pu";
iMMC11.DAT1.$assign                = "MMC1_DAT1";
iMMC11.DAT2.pu_pd                  = "pu";
iMMC11.DAT2.$assign                = "MMC1_DAT2";
iMMC11.DAT3.pu_pd                  = "pu";
iMMC11.DAT3.$assign                = "MMC1_DAT3";
iMMC11.SDCD.pu_pd                  = "pu";
iMMC11.SDCD.$assign                = "MMC1_SDCD";
iMMC11.SDCD.$used                  = true;
const iMMC21                       = scripting.addPeripheral("MMC2");
iMMC21.$useCase                    = "MMC2_3";
iMMC21.$name                       = "MMC2-WIFI";
iMMC21.$assign                     = "MMC2";
iMMC21.$assignVoltage              = "3.3 V";
iMMC21.CMD.pu_pd                   = "pu";
iMMC21.CMD.$assign                 = "MMC2_CMD";
iMMC21.CLK.$assign                 = "MMC2_CLK";
iMMC21.DAT0.pu_pd                  = "pu";
iMMC21.DAT0.$assign                = "MMC2_DAT0";
iMMC21.DAT1.pu_pd                  = "pu";
iMMC21.DAT1.$assign                = "MMC2_DAT1";
iMMC21.DAT2.pu_pd                  = "pu";
iMMC21.DAT2.$assign                = "MMC2_DAT2";
iMMC21.DAT3.pu_pd                  = "pu";
iMMC21.DAT3.$assign                = "MMC2_DAT3";
const iRGMII1                      = scripting.addPeripheral("RGMII");
iRGMII1.$name                      = "RGMII1";
iRGMII1.$assign                    = "RGMII1";
iRGMII1.$assignVoltage             = "3.3 V";
iRGMII1.RD0.$assign                = "RGMII1_RD0";
iRGMII1.RD1.$assign                = "RGMII1_RD1";
iRGMII1.RD2.$assign                = "RGMII1_RD2";
iRGMII1.RD3.$assign                = "RGMII1_RD3";
iRGMII1.RXC.$assign                = "RGMII1_RXC";
iRGMII1.RX_CTL.$assign             = "RGMII1_RX_CTL";
iRGMII1.TD0.rx                     = false;
iRGMII1.TD0.$assign                = "RGMII1_TD0";
iRGMII1.TD1.rx                     = false;
iRGMII1.TD1.$assign                = "RGMII1_TD1";
iRGMII1.TD2.rx                     = false;
iRGMII1.TD2.$assign                = "RGMII1_TD2";
iRGMII1.TD3.rx                     = false;
iRGMII1.TD3.$assign                = "RGMII1_TD3";
iRGMII1.TXC.rx                     = false;
iRGMII1.TXC.$assign                = "RGMII1_TXC";
iRGMII1.TX_CTL.rx                  = false;
iRGMII1.TX_CTL.$assign             = "RGMII1_TX_CTL";
const iRGMII2                      = scripting.addPeripheral("RGMII");
iRGMII2.$name                      = "RGMII2";
iRGMII2.$assign                    = "RGMII2";
iRGMII2.$assignVoltage             = "3.3 V";
iRGMII2.RD0.$assign                = "RGMII2_RD0";
iRGMII2.RD1.$assign                = "RGMII2_RD1";
iRGMII2.RD2.$assign                = "RGMII2_RD2";
iRGMII2.RD3.$assign                = "RGMII2_RD3";
iRGMII2.RXC.$assign                = "RGMII2_RXC";
iRGMII2.RX_CTL.$assign             = "RGMII2_RX_CTL";
iRGMII2.TD0.rx                     = false;
iRGMII2.TD0.$assign                = "RGMII2_TD0";
iRGMII2.TD1.rx                     = false;
iRGMII2.TD1.$assign                = "RGMII2_TD1";
iRGMII2.TD2.rx                     = false;
iRGMII2.TD2.$assign                = "RGMII2_TD2";
iRGMII2.TD3.rx                     = false;
iRGMII2.TD3.$assign                = "RGMII2_TD3";
iRGMII2.TXC.rx                     = false;
iRGMII2.TXC.$assign                = "RGMII2_TXC";
iRGMII2.TX_CTL.rx                  = false;
iRGMII2.TX_CTL.$assign             = "RGMII2_TX_CTL";
const iSPI1                        = scripting.addPeripheral("SPI");
iSPI1.$useCase                     = "SPI_1";
iSPI1.$name                        = "SPI1";
iSPI1.$assign                      = "SPI1";
iSPI1.$assignVoltage               = "3.3 V";
iSPI1.CLK.rx                       = false;
iSPI1.CLK.$assignAllowConflicts    = "OSPI0_D5";
iSPI1.D0.$assignAllowConflicts     = "OSPI0_D6";
iSPI1.D1.$assignAllowConflicts     = "OSPI0_D7";
iSPI1.CS0.$assignAllowConflicts    = "OSPI0_D4";
const iSYSTEM1                     = scripting.addPeripheral("SYSTEM");
iSYSTEM1.$name                     = "SYSTEM0";
iSYSTEM1.$assign                   = "SYSTEM0";
iSYSTEM1.$assignVoltage            = "3.3 V";
iSYSTEM1.CLKOUT0.$assign           = "EXT_REFCLK1";
iSYSTEM1.CLKOUT0.$used             = true;
iSYSTEM1.EXTINTn.$assign           = "EXTINTn";
iSYSTEM1.EXTINTn.$used             = true;
iSYSTEM1.PORz_OUT.$assign          = "PORz_OUT";
iSYSTEM1.RESETSTATz.$assign        = "RESETSTATz";
iSYSTEM1.RESET_REQz.$assign        = "RESET_REQz";
const iUART1                       = scripting.addPeripheral("UART");
iUART1.$useCase                    = "UART_5";
iUART1.$name                       = "UART0-Service";
iUART1.$assign                     = "USART0";
iUART1.$assignVoltage              = "3.3 V";
iUART1.RXD.pu_pd                   = "pu";
iUART1.RXD.$assign                 = "UART0_RXD";
iUART1.TXD.pu_pd                   = "pu";
iUART1.TXD.$assign                 = "UART0_TXD";
const iUART2                       = scripting.addPeripheral("UART");
iUART2.$useCase                    = "UART_5";
iUART2.$name                       = "UART6-USB_UART_Cereal";
iUART2.$assign                     = "USART6";
iUART2.RXD.$assign                 = "MCASP0_AXR3";
iUART2.TXD.$assign                 = "GPMC0_WPn";
const iUART3                       = scripting.addPeripheral("UART");
iUART3.$useCase                    = "UART_5";
iUART3.$name                       = "UART4";
iUART3.$assign                     = "USART4";
iUART3.$assignVoltage              = "3.3 V";
iUART3.RXD.pu_pd                   = "pu";
iUART3.RXD.$assignAllowConflicts   = "MMC2_SDCD";
iUART3.TXD.$assignAllowConflicts   = "MMC2_SDWP";
const iUSB1                        = scripting.addPeripheral("USB");
iUSB1.$name                        = "USB0";
iUSB1.$assign                      = "USB0";
iUSB1.$assignVoltage               = "3.3 V";
iUSB1.DM.$assign                   = "USB0_DM";
iUSB1.DP.$assign                   = "USB0_DP";
iUSB1.DRVVBUS.$used                = false;
iUSB1.RCALIB.$assign               = "USB0_RCALIB";
iUSB1.VBUS.$assign                 = "USB0_VBUS";
const iUSB2                        = scripting.addPeripheral("USB");
iUSB2.$name                        = "USB1";
iUSB2.$assign                      = "USB1";
iUSB2.$assignVoltage               = "3.3 V";
iUSB2.DM.$assign                   = "USB1_DM";
iUSB2.DP.$assign                   = "USB1_DP";
iUSB2.DRVVBUS.$used                = false;
iUSB2.RCALIB.$assign               = "USB1_RCALIB";
iUSB2.VBUS.$assign                 = "USB1_VBUS";
const iWKUP_SYSTEM1                = scripting.addPeripheral("WKUP_SYSTEM");
iWKUP_SYSTEM1.$name                = "WKUP_SYSTEM";
iWKUP_SYSTEM1.$assign              = "WKUP_SYSTEM";
iWKUP_SYSTEM1.$assignVoltage       = "3.3 V";
iWKUP_SYSTEM1.WKUP_CLKOUT0.$assign = "WKUP_CLKOUT0";
iWKUP_SYSTEM1.PMIC_LPM_EN0.$assign = "PMIC_LPM_EN0";

/**
 * Pinmux solution for unlocked pins/peripherals. This ensures that minor changes to the automatic solver in a future
 * version of the tool will not impact the pinmux you originally saw.  These lines can be completely deleted in order to
 * re-solve from scratch.
 */
iGPIO1.$suggestSolution    = "GPIO0";
iMCU_I2C1.$suggestSolution = "MCU_I2C0";
iMDIO1.$suggestSolution    = "MDIO0";

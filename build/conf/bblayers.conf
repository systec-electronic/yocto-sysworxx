## build/conf/bblayers.conf
```bitbake
# This template file was created by taking the oe-core/meta/conf/bblayers.conf
# file and removing the BBLAYERS section at the end.

# LAYER_CONF_VERSION is increased each time build/conf/bblayers.conf
# changes incompatibly
LCONF_VERSION = "7"

BBPATH = "${TOPDIR}"
BBFILES ?= ""

# Layers configured by oe-core-setup script
BBLAYERS += " \
    ${OEBASE}/sources/meta-sysworxx \
    ${OEBASE}/sources/meta-yocto/meta-poky \
    ${OEBASE}/sources/meta-openembedded/meta-networking \
    ${OEBASE}/sources/meta-openembedded/meta-python \
    ${OEBASE}/sources/meta-openembedded/meta-oe \
    ${OEBASE}/sources/meta-openembedded/meta-gnome \
    ${OEBASE}/sources/meta-openembedded/meta-filesystems \
    ${OEBASE}/sources/meta-openembedded/meta-multimedia \
    ${OEBASE}/sources/meta-ti/meta-ti-extras \
    ${OEBASE}/sources/meta-ti/meta-ti-bsp \
    ${OEBASE}/sources/meta-arm/meta-arm \
    ${OEBASE}/sources/meta-arm/meta-arm-toolchain \
    ${OEBASE}/sources/oe-core/meta \
    ${OEBASE}/sources/meta-arago/meta-arago-extras \
    ${OEBASE}/sources/meta-arago/meta-arago-test \
"
```

## sources/meta-cve/conf/layer.conf
```bitbake
BBPATH .= ":${LAYERDIR}"
BBFILES += "${LAYERDIR}/recipes-*/*/*.bb \
            ${LAYERDIR}/recipes-*/*/*.bbappend"

BBFILE_COLLECTIONS += "cve"
BBFILE_PATTERN_cve = "^${LAYERDIR}/"
BBFILE_PRIORITY_cve = "6"

LAYERSERIES_COMPAT_cve = "scarthgap"
```

## sources/meta-sysworxx/conf/distro/sysworxx.conf
```bitbake
require conf/distro/poky.conf

DISTRO = "sysworxx"
DISTRO_NAME = "sysWORXX distro based on poky"

SDK_VENDOR = "-sysworxxsdk"

MAINTAINER = "Andreas Dinter <andreas.dinter@systec-electronic.com>"

TARGET_VENDOR = "-sysworxx"
DISTROOVERRIDES = "sysworxx"

# Log information on images and packages
INHERIT += "buildhistory"
BUILDHISTORY_COMMIT = "1"

# orig: acl alsa argp bluetooth debuginfod ext2 ipv4 ipv6 largefile pcmcia usbgadget
#       usbhost wifi xattr nfs zeroconf pci 3g nfc x11 vfat seccomp largefile
#       opengl ptest multiarch wayland vulkan systemd pulseaudio
#       gobject-introspection-data ldconfig
DISTRO_FEATURES:remove="alsa debuginfod pcmcia nfs zeroconf nfc x11 wayland opengl vulkan opencv pulseaudio sysvinit"
DISTRO_FEATURES:append = " virtualization"

# use systemd
INIT_MANAGER = "systemd"
VIRTUAL-RUNTIME_syslog = ""
VIRTUAL-RUNTIME_base-utils-syslog = ""
PACKAGECONFIG:remove:pn-systemd = " networkd"

# This is needed to not depend on meta-arago-distro which in turn would depend
# on qt5.
BBMASK += ".*meta-toolchain-arago"
BBMASK += ".*tisdk-base-image"

# Wifi/Bluetooth
PREFERRED_PROVIDER_wpa-supplicant = "summit-supplicant-lwb-if"
PREFERRED_PROVIDER_wpa-supplicant-cli = "summit-supplicant-lwb-if-cli"
PREFERRED_PROVIDER_wpa-supplicant-passphrase = "summit-supplicant-lwb-if-passphrase"
BBMASK += " \
    meta-summit-radio/meta-summit-radio/recipes-packages/openssl \
    meta-summit-radio/meta-summit-radio/recipes-packages/.*/.*openssl10.* \
    "
PREFERRED_RPROVIDER_wireless-regdb-static = "wireless-regdb"
LWB_REGDOMAIN = "ETSI"

USERADDEXTENSION += "useradd-staticids"
USERADD_UID_TABLES = "files/passwd"
USERADD_GID_TABLES = "files/group"
# USERADD_ERROR_DYNAMIC = "warn"
USERADD_ERROR_DYNAMIC = "1"

# set root home directory
ROOT_HOME = "/home/root"

# enable persistent journal
VOLATILE_LOG_DIR="no"

INITRAMFS_IMAGE ?= "sysworxx-image-initramfs"
INITRAMFS_IMAGE_BUNDLE ?= "1"
```

## sources/meta-sysworxx/conf/layer.conf
```bitbake
# We have a conf and classes directory, append to BBPATH
BBPATH .= ":${LAYERDIR}"

# We have a recipes directory, add to BBFILES
BBFILES += "${LAYERDIR}/recipes*/*/*.bb ${LAYERDIR}/recipes*/*/*.bbappend"

BBFILE_COLLECTIONS += "meta-sysworxx"
BBFILE_PATTERN_meta-sysworxx := "^${LAYERDIR}/"
BBFILE_PRIORITY_meta-sysworxx = "10"

META_SYSWORXX_DIR="${LAYERDIR}"

LAYERSERIES_COMPAT_meta-sysworxx = "scarthgap"

LAYERDEPENDS_meta-sysworxx = " \
    core \
"

BBFILES_DYNAMIC += "\
    rauc:${LAYERDIR}/dynamic-layers/meta-rauc/*/*/*.bb \
    rauc:${LAYERDIR}/dynamic-layers/meta-rauc/*/*/*.bbappend \
    rauc:${LAYERDIR}/dynamic-layers/meta-chromium/*/*/*.bb \
    rauc:${LAYERDIR}/dynamic-layers/meta-chromium/*/*/*.bbappend \
"
```

## sources/meta-sysworxx/conf/machine/ctr-700.conf
```bitbake
#@TYPE: Machine
#@NAME: sysWORXX CTR-700
#@DESCRIPTION: Machine configuration for the sysWORXX CTR-700

require conf/machine/include/am62xx.inc
require conf/machine/include/ti-extras.inc

# all device trees with this prefix will be included
# see sources/meta-ti/meta-ti-bsp/recipes-kernel/linux/ti-kernel-devicetree-prefix.inc
KERNEL_DEVICETREE_PREFIX = "ti/k3-am623"

# not sure why we even need this:
KERNEL_DEVICETREE = " \
    ti/am623-systec-ctr700-rev2.dtb \
"

UBOOT_MACHINE = "am62x_evm_a53_defconfig"

SERIAL_CONSOLES = "115200;ttyS2"
```

## sources/meta-sysworxx/conf/machine/sysworxx-ctr.conf
```bitbake
#@TYPE: Machine
#@NAME: SYSTEC sysWORXX CTR-800
#@DESCRIPTION: Machine configuration for the sysWORXX CTR-800

require conf/machine/include/am62xx.inc
require conf/machine/include/ti-extras.inc

KERNEL_DEVICETREE = " \
    ti/k3-am623-systec-fallback.dtb \
    ti/k3-am623-systec-ctr-prodtest.dtb \
    ti/k3-am623-systec-ctr800-rev0.dtb \
"

UBOOT_MACHINE = "am62x_evm_a53_defconfig"
UBOOT_CONFIG_FRAGMENTS = "am625_sysworxx_a53.config"

MACHINE_FEATURES += "bluetooth"

SERIAL_CONSOLES = "115200;ttyS2"
```

## sources/meta-sysworxx/conf/machine/sysworxx.conf
```bitbake
#@TYPE: Machine
#@NAME: SYSTEC sysWORXX series
#@DESCRIPTION: Machine configuration for the sysWORXX devices

require conf/machine/include/am62xx.inc
require conf/machine/include/ti-extras.inc

KERNEL_DEVICETREE = " \
    ti/k3-am623-systec-fallback.dtb \
    ti/k3-am623-systec-ctr-prodtest.dtb \
    ti/k3-am623-systec-ctr600-rev0.dtb \
    ti/k3-am623-systec-ctr800-rev0.dtb \
    ti/k3-am625-systec-pi-rev0.dtb \
    ti/k3-am625-systec-pi-sysworxx-io-gpio.dtbo \
    ti/k3-am625-systec-sysworxx-pi-hat-smart-metering.dtbo \
    ti/k3-am625-systec-sysworxx-pi-hat-industrial-communication.dtbo \
"

IMAGE_BOOT_FILES=" \
    tiboot3-am62x-gp-evm.bin;tiboot3.bin \
    tispl.bin \
    u-boot.img \
"

UBOOT_MACHINE = "am62x_evm_a53_defconfig"

MACHINE_FEATURES += "bluetooth"
MACHINE_FEATURES:remove = "efi"

SERIAL_CONSOLES = "115200;ttyS2"
```

## sources/meta-sysworxx/wic/sdimage-sysworxx-rauc.wks
```
part --type primary --source bootimg-partition --fstype=vfat --label boot --active --align 1024 --use-uuid --fixed-size 4M
part --type primary --fstype=vfat --label uboot-env --align 1024 --size 4M
part --type logical / --fixed-size 2560M --source rootfs --fstype=ext4 --label rootfs.0 --align 1024 --use-uuid
part --type logical / --fixed-size 2560M --source rootfs --fstype=ext4 --label rootfs.1 --align 1024 --use-uuid
part --type logical /home --fixed-size 1000M --fstype=ext4 --label user --align 1024 --use-uuid
```

## sources/meta-sysworxx/wic/sdimage-sysworxx.wks
```
part --type primary --source bootimg-partition --fstype=vfat --label boot --active --align 1024 --use-uuid --fixed-size 4M
part --type primary --fstype=vfat --label uboot-env --align 1024 --size 4M
part --type logical / --source rootfs --fstype=ext4 --label rootfs --align 1024 --use-uuid
```

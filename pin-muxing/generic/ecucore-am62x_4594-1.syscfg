/**
 * @cliArgs --device "AM62x" --package "ALW" --part "Default"
 * @versions {"tool":"1.20.0+3587"}
 */

/**
 * Import the modules used in this configuration.
 */
const powerDomains = scripting.addModule("/ti/corePinmux/powerDomains");

/**
 * Write custom configuration values to the imported modules.
 */
powerDomains.VDDSHV0                      = "3.3 V";
powerDomains.VDDSHV2                      = "3.3 V";
powerDomains.VDDSHV3                      = "3.3 V";
powerDomains.VDDSHV_MCU                   = "3.3 V";
powerDomains.VDDSHV_CANUART               = "3.3 V";
powerDomains["VDDA_1P8_USB-VDDA_3P3_USB"] = "3.3 V";
powerDomains.VDDSHV1                      = "3.3 V";
powerDomains.VDDSHV5                      = "3.3 V";
powerDomains.VDDSHV6                      = "3.3 V";
powerDomains["VDDS_DDR-VDDS_DDR_C"]       = "1.2 V";

/**
 * These are the peripherals and settings in this configuration
 */
const iDDRSS1                      = scripting.addPeripheral("DDRSS");
iDDRSS1.$name                      = "DDR";
iDDRSS1.$assign                    = "DDR0";
iDDRSS1.$assignVoltage             = "1.2 V";
iDDRSS1.A0.$assign                 = "DDR0_A0";
iDDRSS1.A1.$assign                 = "DDR0_A1";
iDDRSS1.A10.$assign                = "DDR0_A10";
iDDRSS1.A11.$assign                = "DDR0_A11";
iDDRSS1.A12.$assign                = "DDR0_A12";
iDDRSS1.A13.$assign                = "DDR0_A13";
iDDRSS1.A2.$assign                 = "DDR0_A2";
iDDRSS1.A3.$assign                 = "DDR0_A3";
iDDRSS1.A4.$assign                 = "DDR0_A4";
iDDRSS1.A5.$assign                 = "DDR0_A5";
iDDRSS1.A6.$assign                 = "DDR0_A6";
iDDRSS1.A7.$assign                 = "DDR0_A7";
iDDRSS1.A8.$assign                 = "DDR0_A8";
iDDRSS1.A9.$assign                 = "DDR0_A9";
iDDRSS1.ACT_n.$assign              = "DDR0_ACT_n";
iDDRSS1.ALERT_n.$assign            = "DDR0_ALERT_n";
iDDRSS1.BA0.$assign                = "DDR0_BA0";
iDDRSS1.BA1.$assign                = "DDR0_BA1";
iDDRSS1.BG0.$assign                = "DDR0_BG0";
iDDRSS1.BG1.$used                  = false;
iDDRSS1.CAS_n.$assign              = "DDR0_CAS_n";
iDDRSS1.CK0.$assign                = "DDR0_CK0";
iDDRSS1.CK0_n.$assign              = "DDR0_CK0_n";
iDDRSS1.CKE0.$assign               = "DDR0_CKE0";
iDDRSS1.CKE1.$used                 = false;
iDDRSS1.CS0_n.$assign              = "DDR0_CS0_n";
iDDRSS1.CS1_n.$used                = false;
iDDRSS1.DM0.$assign                = "DDR0_DM0";
iDDRSS1.DM1.$assign                = "DDR0_DM1";
iDDRSS1.DQ0.$assign                = "DDR0_DQ0";
iDDRSS1.DQ1.$assign                = "DDR0_DQ1";
iDDRSS1.DQ10.$assign               = "DDR0_DQ10";
iDDRSS1.DQ11.$assign               = "DDR0_DQ11";
iDDRSS1.DQ12.$assign               = "DDR0_DQ12";
iDDRSS1.DQ13.$assign               = "DDR0_DQ13";
iDDRSS1.DQ14.$assign               = "DDR0_DQ14";
iDDRSS1.DQ15.$assign               = "DDR0_DQ15";
iDDRSS1.DQ2.$assign                = "DDR0_DQ2";
iDDRSS1.DQ3.$assign                = "DDR0_DQ3";
iDDRSS1.DQ4.$assign                = "DDR0_DQ4";
iDDRSS1.DQ5.$assign                = "DDR0_DQ5";
iDDRSS1.DQ6.$assign                = "DDR0_DQ6";
iDDRSS1.DQ7.$assign                = "DDR0_DQ7";
iDDRSS1.DQ8.$assign                = "DDR0_DQ8";
iDDRSS1.DQ9.$assign                = "DDR0_DQ9";
iDDRSS1.DQS0.$assign               = "DDR0_DQS0";
iDDRSS1.DQS0_n.$assign             = "DDR0_DQS0_n";
iDDRSS1.DQS1.$assign               = "DDR0_DQS1";
iDDRSS1.DQS1_n.$assign             = "DDR0_DQS1_n";
iDDRSS1.ODT0.$assign               = "DDR0_ODT0";
iDDRSS1.ODT1.$used                 = false;
iDDRSS1.PAR.$assign                = "DDR0_PAR";
iDDRSS1.RAS_n.$assign              = "DDR0_RAS_n";
iDDRSS1.RESET0_n.$assign           = "DDR0_RESET0_n";
iDDRSS1.WE_n.$assign               = "DDR0_WE_n";
iDDRSS1.CAL0.$assign               = "DDR0_CAL0";
const iECAP1                       = scripting.addPeripheral("ECAP");
iECAP1.$name                       = "ECAP1";
iECAP1.$assign                     = "ECAP1";
iECAP1.$assignVoltage              = "3.3 V";
iECAP1.IN_APWM_OUT.$assign         = "MCASP0_AXR1";
const iEPWM1                       = scripting.addPeripheral("EPWM");
iEPWM1.$useCase                    = "EPWM_1";
iEPWM1.$name                       = "PWM1_DO14";
iEPWM1.$assign                     = "EHRPWM1";
iEPWM1.$assignVoltage              = "3.3 V";
iEPWM1.A.$assign                   = "MCASP0_AXR1";
const iEPWM2                       = scripting.addPeripheral("EPWM");
iEPWM2.$useCase                    = "EPWM_1";
iEPWM2.$name                       = "PWM2_DO15";
iEPWM2.$assign                     = "EHRPWM2";
iEPWM2.$assignVoltage              = "3.3 V";
iEPWM2.A.$assign                   = "I2C1_SCL";
const iEQEP1                       = scripting.addPeripheral("EQEP");
iEQEP1.$name                       = "EQEP0_DI14_DI15";
iEQEP1.$assign                     = "EQEP1";
iEQEP1.$assignVoltage              = "3.3 V";
iEQEP1.A.$assign                   = "MCASP0_ACLKX";
iEQEP1.B.$assign                   = "MCASP0_AFSX";
iEQEP1.I.$used                     = false;
iEQEP1.S.$used                     = false;
const iGPIO1                       = scripting.addPeripheral("GPIO");
iGPIO1["0"].$assign                = "OSPI0_CLK";
iGPIO1["0"].$used                  = true;
iGPIO1["1"].$assign                = "OSPI0_LBCLKO";
iGPIO1["2"].$assign                = "OSPI0_DQS";
iGPIO1["3"].$assign                = "OSPI0_D0";
iGPIO1["3"].$used                  = true;
iGPIO1["4"].$assign                = "OSPI0_D1";
iGPIO1["4"].$used                  = true;
iGPIO1["5"].$assign                = "OSPI0_D2";
iGPIO1["5"].$used                  = true;
iGPIO1["6"].$assign                = "OSPI0_D3";
iGPIO1["6"].$used                  = true;
iGPIO1["7"].$assign                = "OSPI0_D4";
iGPIO1["7"].$used                  = true;
iGPIO1["11"].$assign               = "OSPI0_CSn0";
iGPIO1["11"].$used                 = true;
iGPIO1["12"].$assign               = "OSPI0_CSn1";
iGPIO1["12"].$used                 = true;
iGPIO1["13"].$assign               = "OSPI0_CSn2";
iGPIO1["14"].$assign               = "OSPI0_CSn3";
iGPIO1["15"].$assign               = "GPMC0_AD0";
iGPIO1["16"].$assign               = "GPMC0_AD1";
iGPIO1["17"].$assign               = "GPMC0_AD2";
iGPIO1["17"].$used                 = true;
iGPIO1["18"].$assign               = "GPMC0_AD3";
iGPIO1["19"].$assign               = "GPMC0_AD4";
iGPIO1["19"].$used                 = true;
iGPIO1["20"].$assign               = "GPMC0_AD5";
iGPIO1["20"].$used                 = true;
iGPIO1["21"].$assign               = "GPMC0_AD6";
iGPIO1["22"].$assign               = "GPMC0_AD7";
iGPIO1["23"].$assign               = "GPMC0_AD8";
iGPIO1["24"].$assign               = "GPMC0_AD9";
iGPIO1["25"].$assign               = "GPMC0_AD10";
iGPIO1["26"].$assign               = "GPMC0_AD11";
iGPIO1["26"].$used                 = true;
iGPIO1["27"].$assign               = "GPMC0_AD12";
iGPIO1["28"].$assign               = "GPMC0_AD13";
iGPIO1["29"].$assign               = "GPMC0_AD14";
iGPIO1["30"].$assign               = "GPMC0_AD15";
iGPIO1["31"].$assign               = "GPMC0_CLK";
iGPIO1["31"].$used                 = true;
iGPIO1["32"].$assign               = "GPMC0_ADVn_ALE";
iGPIO1["32"].$used                 = true;
iGPIO1["33"].$assign               = "GPMC0_OEn_REn";
iGPIO1["33"].$used                 = true;
iGPIO1["34"].$assign               = "GPMC0_WEn";
iGPIO1["34"].$used                 = true;
iGPIO1["35"].$assign               = "GPMC0_BE0n_CLE";
iGPIO1["35"].$used                 = true;
iGPIO1["36"].$assign               = "GPMC0_BE1n";
iGPIO1["36"].$used                 = true;
iGPIO1["37"].$assign               = "GPMC0_WAIT0";
iGPIO1["37"].$used                 = true;
iGPIO1["38"].$assign               = "GPMC0_WAIT1";
iGPIO1["38"].$used                 = true;
iGPIO1["39"].$assign               = "GPMC0_WPn";
iGPIO1["39"].$used                 = true;
iGPIO1["40"].$assign               = "GPMC0_DIR";
iGPIO1["40"].$used                 = true;
iGPIO1["41"].$assign               = "GPMC0_CSn0";
iGPIO1["41"].$used                 = true;
iGPIO1["42"].$assign               = "GPMC0_CSn1";
iGPIO1["42"].$used                 = true;
iGPIO1["43"].$assign               = "GPMC0_CSn2";
iGPIO1["43"].$used                 = true;
iGPIO1["44"].$assign               = "GPMC0_CSn3";
iGPIO1["45"].$assign               = "VOUT0_DATA0";
iGPIO1["45"].$used                 = true;
iGPIO1["46"].$assign               = "VOUT0_DATA1";
iGPIO1["46"].$used                 = true;
iGPIO1["47"].$assign               = "VOUT0_DATA2";
iGPIO1["47"].$used                 = true;
iGPIO1["48"].$assign               = "VOUT0_DATA3";
iGPIO1["48"].$used                 = true;
iGPIO1["49"].$assign               = "VOUT0_DATA4";
iGPIO1["50"].$assign               = "VOUT0_DATA5";
iGPIO1["51"].$assign               = "VOUT0_DATA6";
iGPIO1["51"].$used                 = true;
iGPIO1["52"].$assign               = "VOUT0_DATA7";
iGPIO1["52"].$used                 = true;
iGPIO1["53"].$assign               = "VOUT0_DATA8";
iGPIO1["54"].$assign               = "VOUT0_DATA9";
iGPIO1["55"].$assign               = "VOUT0_DATA10";
iGPIO1["56"].$assign               = "VOUT0_DATA11";
iGPIO1["57"].$assign               = "VOUT0_DATA12";
iGPIO1["57"].$used                 = true;
iGPIO1["58"].$assign               = "VOUT0_DATA13";
iGPIO1["58"].$used                 = true;
iGPIO1["59"].$assign               = "VOUT0_DATA14";
iGPIO1["59"].$used                 = true;
iGPIO1["60"].$assign               = "VOUT0_DATA15";
iGPIO1["60"].$used                 = true;
iGPIO1["61"].$assign               = "VOUT0_HSYNC";
iGPIO1["61"].$used                 = true;
iGPIO1["62"].$assign               = "VOUT0_DE";
iGPIO1["62"].$used                 = true;
iGPIO1["63"].$assign               = "VOUT0_VSYNC";
iGPIO1["63"].$used                 = true;
iGPIO1["64"].$assign               = "VOUT0_PCLK";
iGPIO1["64"].$used                 = true;
iGPIO1["71"].$assign               = "MMC2_SDCD";
iGPIO1["71"].$used                 = true;
iGPIO1["72"].$assign               = "MMC2_SDWP";
iGPIO1["72"].$used                 = true;
iGPIO1["85"].pu_pd                 = "pu";
iGPIO1["85"].$assign               = "MDIO0_MDIO";
iGPIO1["85"].$used                 = true;
iGPIO1["86"].pu_pd                 = "pu";
iGPIO1["86"].rx                    = false;
iGPIO1["86"].$assign               = "MDIO0_MDC";
iGPIO1["86"].$used                 = true;
iGPIO1.$name                       = "GPIO0";
iGPIO1.$assign                     = "GPIO0";
iGPIO1.$assignVoltage              = "3.3 V";
const iGPIO2                       = scripting.addPeripheral("GPIO");
iGPIO2["10"].$assign               = "MCASP0_AXR0";
iGPIO2["10"].$used                 = true;
iGPIO2["12"].$assign               = "MCASP0_AFSX";
iGPIO2["13"].$assign               = "MCASP0_AFSR";
iGPIO2["14"].$assign               = "MCASP0_ACLKR";
iGPIO2["15"].$assign               = "SPI0_CS0";
iGPIO2["15"].$used                 = true;
iGPIO2["17"].$assign               = "SPI0_CLK";
iGPIO2["18"].$assign               = "SPI0_D0";
iGPIO2["19"].$assign               = "SPI0_D1";
iGPIO2["24"].$assign               = "MCAN0_TX";
iGPIO2["25"].$assign               = "MCAN0_RX";
iGPIO2["29"].$assign               = "I2C1_SDA";
iGPIO2["29"].$used                 = true;
iGPIO2["49"].$assign               = "MMC1_SDWP";
iGPIO2["49"].$used                 = true;
iGPIO2["51"].$assign               = "USB1_DRVVBUS";
iGPIO2.$name                       = "GPIO1";
iGPIO2.$assign                     = "GPIO1";
iGPIO2.$assignVoltage              = "3.3 V";
const iI2C1                        = scripting.addPeripheral("I2C");
iI2C1.$name                        = "I2C3_Board";
iI2C1.$assign                      = "I2C3";
iI2C1.$assignVoltage               = "3.3 V";
iI2C1.SCL.$assign                  = "UART0_CTSn";
iI2C1.SDA.$assign                  = "UART0_RTSn";
const iI2C2                        = scripting.addPeripheral("I2C");
iI2C2.$name                        = "I2C0_SOM";
iI2C2.$assign                      = "I2C0";
iI2C2.$assignVoltage               = "3.3 V";
iI2C2.SCL.$assign                  = "I2C0_SCL";
iI2C2.SDA.$assign                  = "I2C0_SDA";
const iJTAG1                       = scripting.addPeripheral("JTAG");
iJTAG1.$name                       = "MCU-JTAG";
iJTAG1.$assign                     = "MCU_DEBUG0";
iJTAG1.$assignVoltage              = "3.3 V";
iJTAG1.EMU0.$assign                = "EMU0";
iJTAG1.EMU1.$assign                = "EMU1";
iJTAG1.TCK.$assign                 = "TCK";
iJTAG1.TDI.$assign                 = "TDI";
iJTAG1.TDO.$assign                 = "TDO";
iJTAG1.TMS.$assign                 = "TMS";
iJTAG1.TRSTn.$assign               = "TRSTn";
const iMCAN1                       = scripting.addPeripheral("MCAN");
iMCAN1.$useCase                    = "MCAN_1";
iMCAN1.$name                       = "MCAN0";
iMCAN1.$assign                     = "MCAN0";
iMCAN1.$assignVoltage              = "3.3 V";
iMCAN1.RX.$assign                  = "MCAN0_RX";
iMCAN1.TX.$assign                  = "MCAN0_TX";
const iMCU_GPIO1                   = scripting.addPeripheral("MCU_GPIO");
iMCU_GPIO1["17"].$assign           = "MCU_I2C0_SCL";
iMCU_GPIO1["17"].$used             = true;
iMCU_GPIO1["18"].$assign           = "MCU_I2C0_SDA";
iMCU_GPIO1["18"].$used             = true;
iMCU_GPIO1.$name                   = "MCU_GPIO0";
iMCU_GPIO1.$assign                 = "MCU_GPIO0";
iMCU_GPIO1.$assignVoltage          = "3.3 V";
const iMCU_MCAN1                   = scripting.addPeripheral("MCU_MCAN");
iMCU_MCAN1.$useCase                = "MCU_MCAN_1";
iMCU_MCAN1.$name                   = "MCU_MCAN0";
iMCU_MCAN1.$assign                 = "MCU_MCAN0";
iMCU_MCAN1.$assignVoltage          = "3.3 V";
iMCU_MCAN1.RX.$assign              = "MCU_MCAN0_RX";
iMCU_MCAN1.TX.$assign              = "MCU_MCAN0_TX";
const iMCU_SYSTEM1                 = scripting.addPeripheral("MCU_SYSTEM");
iMCU_SYSTEM1.$name                 = "MCU_SYSTEM0";
iMCU_SYSTEM1.$assign               = "MCU_SYSTEM0";
iMCU_SYSTEM1.$assignVoltage        = "3.3 V";
iMCU_SYSTEM1.MCU_ERRORn.$used      = false;
iMCU_SYSTEM1.MCU_EXT_REFCLK0.$used = false;
iMCU_SYSTEM1.MCU_OBSCLK0.$assign   = "MCU_SPI0_CS1";
iMCU_SYSTEM1.MCU_PORz.$used        = false;
iMCU_SYSTEM1.MCU_RESETSTATz.$used  = false;
iMCU_SYSTEM1.MCU_RESETz.$used      = false;
iMCU_SYSTEM1.MCU_SYSCLKOUT0.$used  = false;
const iMCU_UART1                   = scripting.addPeripheral("MCU_UART");
iMCU_UART1.$useCase                = "MCU_UART_1";
iMCU_UART1.$name                   = "MCU_UART0-Bluetooth";
iMCU_UART1.$assign                 = "MCU_USART0";
iMCU_UART1.$assignVoltage          = "3.3 V";
iMCU_UART1.RXD.$assign             = "MCU_UART0_RXD";
iMCU_UART1.TXD.$assign             = "MCU_UART0_TXD";
iMCU_UART1.CTSn.$assign            = "MCU_UART0_CTSn";
iMCU_UART1.RTSn.$assign            = "MCU_UART0_RTSn";
const iMMC01                       = scripting.addPeripheral("MMC0");
iMMC01.$useCase                    = "MMC0_3";
iMMC01.$name                       = "MMC0-EMMC";
iMMC01.$assign                     = "MMC0";
iMMC01.$assignVoltage              = "1.8 V";
iMMC01.CMD.$assign                 = "MMC0_CMD";
iMMC01.CLK.$assign                 = "MMC0_CLK";
iMMC01.DAT0.$assign                = "MMC0_DAT0";
iMMC01.DAT1.$assign                = "MMC0_DAT1";
iMMC01.DAT2.$assign                = "MMC0_DAT2";
iMMC01.DAT3.$assign                = "MMC0_DAT3";
iMMC01.DAT4.$assign                = "MMC0_DAT4";
iMMC01.DAT5.$assign                = "MMC0_DAT5";
iMMC01.DAT6.$assign                = "MMC0_DAT6";
iMMC01.DAT7.$assign                = "MMC0_DAT7";
const iMMC11                       = scripting.addPeripheral("MMC1");
iMMC11.$useCase                    = "MMC1_3";
iMMC11.$name                       = "MMC1-SDCARD";
iMMC11.$assign                     = "MMC1";
iMMC11.$assignVoltage              = "3.3 V";
iMMC11.CMD.$assign                 = "MMC1_CMD";
iMMC11.CLK.$assign                 = "MMC1_CLK";
iMMC11.DAT0.$assign                = "MMC1_DAT0";
iMMC11.DAT1.$assign                = "MMC1_DAT1";
iMMC11.DAT2.$assign                = "MMC1_DAT2";
iMMC11.DAT3.$assign                = "MMC1_DAT3";
iMMC11.SDCD.$assign                = "MMC1_SDCD";
iMMC11.SDCD.$used                  = true;
iMMC11.SDWP.$assignAllowConflicts  = "MMC1_SDWP";
const iMMC21                       = scripting.addPeripheral("MMC2");
iMMC21.$useCase                    = "MMC2_3";
iMMC21.$name                       = "MMC2-WIFI";
iMMC21.$assign                     = "MMC2";
iMMC21.$assignVoltage              = "3.3 V";
iMMC21.CMD.$assign                 = "MMC2_CMD";
iMMC21.CLK.$assign                 = "MMC2_CLK";
iMMC21.DAT0.$assign                = "MMC2_DAT0";
iMMC21.DAT1.$assign                = "MMC2_DAT1";
iMMC21.DAT2.$assign                = "MMC2_DAT2";
iMMC21.DAT3.$assign                = "MMC2_DAT3";
const iOLDI1                       = scripting.addPeripheral("OLDI");
iOLDI1.$name                       = "OLDI-LVDS0";
iOLDI1.$assign                     = "OLDI0";
iOLDI1.$assignVoltage              = "1.8 V";
iOLDI1.A0N.$assign                 = "OLDI0_A0N";
iOLDI1.A0P.$assign                 = "OLDI0_A0P";
iOLDI1.A1N.$assign                 = "OLDI0_A1N";
iOLDI1.A1P.$assign                 = "OLDI0_A1P";
iOLDI1.A2N.$assign                 = "OLDI0_A2N";
iOLDI1.A2P.$assign                 = "OLDI0_A2P";
iOLDI1.A3N.$assign                 = "OLDI0_A3N";
iOLDI1.A3N.$used                   = false;
iOLDI1.A3P.$assign                 = "OLDI0_A3P";
iOLDI1.A3P.$used                   = false;
iOLDI1.A4N.$assign                 = "OLDI0_A4N";
iOLDI1.A4N.$used                   = false;
iOLDI1.A4P.$assign                 = "OLDI0_A4P";
iOLDI1.A4P.$used                   = false;
iOLDI1.A5N.$assign                 = "OLDI0_A5N";
iOLDI1.A5N.$used                   = false;
iOLDI1.A5P.$assign                 = "OLDI0_A5P";
iOLDI1.A5P.$used                   = false;
iOLDI1.A6N.$assign                 = "OLDI0_A6N";
iOLDI1.A6N.$used                   = false;
iOLDI1.A6P.$assign                 = "OLDI0_A6P";
iOLDI1.A6P.$used                   = false;
iOLDI1.A7N.$assign                 = "OLDI0_A7N";
iOLDI1.A7N.$used                   = false;
iOLDI1.A7P.$assign                 = "OLDI0_A7P";
iOLDI1.A7P.$used                   = false;
iOLDI1.CLK0N.$assign               = "OLDI0_CLK0N";
iOLDI1.CLK0P.$assign               = "OLDI0_CLK0P";
iOLDI1.CLK1N.$assign               = "OLDI0_CLK1N";
iOLDI1.CLK1N.$used                 = false;
iOLDI1.CLK1P.$assign               = "OLDI0_CLK1P";
iOLDI1.CLK1P.$used                 = false;
const iRGMII1                      = scripting.addPeripheral("RGMII");
iRGMII1.$name                      = "RGMII1";
iRGMII1.$assign                    = "RGMII1";
iRGMII1.$assignVoltage             = "3.3 V";
iRGMII1.RD0.$assign                = "RGMII1_RD0";
iRGMII1.RD1.$assign                = "RGMII1_RD1";
iRGMII1.RD2.$assign                = "RGMII1_RD2";
iRGMII1.RD3.$assign                = "RGMII1_RD3";
iRGMII1.RXC.$assign                = "RGMII1_RXC";
iRGMII1.RX_CTL.$assign             = "RGMII1_RX_CTL";
iRGMII1.TD0.$assign                = "RGMII1_TD0";
iRGMII1.TD1.$assign                = "RGMII1_TD1";
iRGMII1.TD2.$assign                = "RGMII1_TD2";
iRGMII1.TD3.$assign                = "RGMII1_TD3";
iRGMII1.TXC.$assign                = "RGMII1_TXC";
iRGMII1.TX_CTL.$assign             = "RGMII1_TX_CTL";
const iRGMII2                      = scripting.addPeripheral("RGMII");
iRGMII2.$name                      = "RGMII2";
iRGMII2.$assign                    = "RGMII2";
iRGMII2.$assignVoltage             = "3.3 V";
iRGMII2.RD0.$assign                = "RGMII2_RD0";
iRGMII2.RD1.$assign                = "RGMII2_RD1";
iRGMII2.RD2.$assign                = "RGMII2_RD2";
iRGMII2.RD3.$assign                = "RGMII2_RD3";
iRGMII2.RXC.$assign                = "RGMII2_RXC";
iRGMII2.RX_CTL.$assign             = "RGMII2_RX_CTL";
iRGMII2.TD0.$assign                = "RGMII2_TD0";
iRGMII2.TD1.$assign                = "RGMII2_TD1";
iRGMII2.TD2.$assign                = "RGMII2_TD2";
iRGMII2.TD3.$assign                = "RGMII2_TD3";
iRGMII2.TXC.$assign                = "RGMII2_TXC";
iRGMII2.TX_CTL.$assign             = "RGMII2_TX_CTL";
const iSPI1                        = scripting.addPeripheral("SPI");
iSPI1.$useCase                     = "SPI_1";
iSPI1.$name                        = "SPI0";
iSPI1.$assign                      = "SPI0";
iSPI1.$assignVoltage               = "3.3 V";
iSPI1.CLK.$assign                  = "SPI0_CLK";
iSPI1.D0.$assign                   = "SPI0_D0";
iSPI1.D1.$assign                   = "SPI0_D1";
iSPI1.CS0.$assign                  = "SPI0_CS0";
iSPI1.CS0.$used                    = false;
const iSPI2                        = scripting.addPeripheral("SPI");
iSPI2.$useCase                     = "SPI_1";
iSPI2.$name                        = "SPI1";
iSPI2.$assign                      = "SPI1";
iSPI2.$assignVoltage               = "3.3 V";
iSPI2.CLK.$assign                  = "OSPI0_D5";
iSPI2.D0.$assign                   = "OSPI0_D6";
iSPI2.D1.$assign                   = "OSPI0_D7";
iSPI2.CS0.$assign                  = "OSPI0_D4";
iSPI2.CS0.$used                    = false;
const iSYSTEM1                     = scripting.addPeripheral("SYSTEM");
iSYSTEM1.$name                     = "SYSTEM0";
iSYSTEM1.$assign                   = "SYSTEM0";
iSYSTEM1.$assignVoltage            = "3.3 V";
iSYSTEM1.CLKOUT0.$assign           = "EXT_REFCLK1";
iSYSTEM1.CLKOUT0.$used             = true;
iSYSTEM1.EXTINTn.$assign           = "EXTINTn";
iSYSTEM1.EXTINTn.$used             = true;
iSYSTEM1.PORz_OUT.$assign          = "PORz_OUT";
iSYSTEM1.RESETSTATz.$assign        = "RESETSTATz";
iSYSTEM1.RESET_REQz.$assign        = "RESET_REQz";
const iUART1                       = scripting.addPeripheral("UART");
iUART1.$useCase                    = "UART_5";
iUART1.$name                       = "UART0-Service";
iUART1.$assign                     = "USART0";
iUART1.$assignVoltage              = "3.3 V";
iUART1.RXD.$assign                 = "UART0_RXD";
iUART1.TXD.$assign                 = "UART0_TXD";
const iUART2                       = scripting.addPeripheral("UART");
iUART2.$useCase                    = "UART_2";
iUART2.$name                       = "UART1-RESERVED";
iUART2.$assign                     = "USART1";
iUART2.$assignVoltage              = "3.3 V";
iUART2.RXD.$assign                 = "MCASP0_AFSR";
iUART2.TXD.$assign                 = "MCASP0_ACLKR";
iUART2.CTSn.$assign                = "MCASP0_AXR3";
iUART2.RTSn.$assign                = "MCASP0_AXR2";
const iUART3                       = scripting.addPeripheral("UART");
iUART3.$useCase                    = "UART_2";
iUART3.$name                       = "UART5-SERIAL1";
iUART3.$assign                     = "USART5";
iUART3.$assignVoltage              = "3.3 V";
iUART3.RXD.$assign                 = "OSPI0_CSn2";
iUART3.TXD.$assign                 = "OSPI0_CSn3";
iUART3.CTSn.$assign                = "OSPI0_DQS";
iUART3.RTSn.$assign                = "OSPI0_LBCLKO";
const iUART4                       = scripting.addPeripheral("UART");
iUART4.$useCase                    = "UART_2";
iUART4.$name                       = "UART6-SERIAL2";
iUART4.$assign                     = "USART6";
iUART4.$assignVoltage              = "3.3 V";
iUART4.RXD.$assign                 = "VOUT0_DATA8";
iUART4.TXD.$assign                 = "VOUT0_DATA9";
iUART4.CTSn.$assign                = "VOUT0_DATA11";
iUART4.RTSn.$assign                = "VOUT0_DATA10";
const iUART5                       = scripting.addPeripheral("UART");
iUART5.$useCase                    = "UART_5";
iUART5.$name                       = "UART4-SERIAL0";
iUART5.$assign                     = "USART4";
iUART5.$assignVoltage              = "3.3 V";
iUART5.RXD.$assign                 = "VOUT0_DATA4";
iUART5.TXD.$assign                 = "VOUT0_DATA5";
const iUSB1                        = scripting.addPeripheral("USB");
iUSB1.$name                        = "USB0";
iUSB1.$assign                      = "USB0";
iUSB1.$assignVoltage               = "3.3 V";
iUSB1.DM.$assign                   = "USB0_DM";
iUSB1.DP.$assign                   = "USB0_DP";
iUSB1.DRVVBUS.$assign              = "USB0_DRVVBUS";
iUSB1.RCALIB.$assign               = "USB0_RCALIB";
iUSB1.VBUS.$assign                 = "USB0_VBUS";
const iUSB2                        = scripting.addPeripheral("USB");
iUSB2.$name                        = "USB1";
iUSB2.$assign                      = "USB1";
iUSB2.$assignVoltage               = "3.3 V";
iUSB2.DM.$assign                   = "USB1_DM";
iUSB2.DP.$assign                   = "USB1_DP";
iUSB2.DRVVBUS.$assign              = "USB1_DRVVBUS";
iUSB2.RCALIB.$assign               = "USB1_RCALIB";
iUSB2.VBUS.$assign                 = "USB1_VBUS";
const iWKUP_SYSTEM1                = scripting.addPeripheral("WKUP_SYSTEM");
iWKUP_SYSTEM1.$name                = "WKUP_SYSTEM";
iWKUP_SYSTEM1.$assign              = "WKUP_SYSTEM";
iWKUP_SYSTEM1.$assignVoltage       = "3.3 V";
iWKUP_SYSTEM1.WKUP_CLKOUT0.$assign = "WKUP_CLKOUT0";
iWKUP_SYSTEM1.PMIC_LPM_EN0.$used   = false;
const iWKUP_UART1                  = scripting.addPeripheral("WKUP_UART");
iWKUP_UART1.$name                  = "WKUP_UART1-RESERVED";
iWKUP_UART1.$assign                = "WKUP_USART0";
iWKUP_UART1.$assignVoltage         = "3.3 V";
iWKUP_UART1.CTSn.$assign           = "WKUP_UART0_CTSn";
iWKUP_UART1.RTSn.$assign           = "WKUP_UART0_RTSn";
iWKUP_UART1.RXD.$assign            = "WKUP_UART0_RXD";
iWKUP_UART1.TXD.$assign            = "WKUP_UART0_TXD";

/**
 * Pinmux solution for unlocked pins/peripherals. This ensures that minor changes to the automatic solver in a future
 * version of the tool will not impact the pinmux you originally saw.  These lines can be completely deleted in order to
 * re-solve from scratch.
 */
iEPWM1.A.$suggestSolution = "<error>";
